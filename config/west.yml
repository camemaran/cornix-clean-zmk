## config/west.yml
```yaml
manifest:
  remotes:
    - name: zmkfirmware
      url-base: https://github.com
    - name: hitsmaxft
      url-base: https://github.com
    - name: urob
      url-base: https://github.com
    - name: janpfischer
      url-base: https://github.com
    - name: wataruw
      url-base: https://github.com
    - name: camemaran
      url-base: https://github.com
  projects:
    - name: zmk
      remote: zmkfirmware
      revision: v0.3-branch
      clone-depth: 1
      import:
        file: app/west.yml
    - name: zmk-helpers
      remote: urob
      # 💎 v0.3のZMK環境と100%完璧に調和する、安定していた過去の時点に固定します
      revision: e200cf563795b5fe38fa59fa0fcf284bf4b8fc4a
      clone-depth: 1
    - name: zmk-rgbled-widget
      remote: hitsmaxft
      # 💎 v0.3のZMK環境と100%完璧に調和する、安定していた過去の時点に固定します
      revision: aa68a44ec2be9e3ee3fb4a7ff90efb22a6b2512f
      clone-depth: 1
  self:
    path: config
```
